## CMakeLists.txt
```
cmake_minimum_required(VERSION 3.20.0)
find_package(Zephyr REQUIRED HINTS $ENV{ZEPHYR_BASE})

project(ot_test)

target_sources(app PRIVATE src/main.c)
```

## prj.conf
```kconfig
# LOG
CONFIG_UART_CONSOLE=y  
CONFIG_LOG=y
CONFIG_LOG_DEFAULT_LEVEL=4
CONFIG_LOG_OVERRIDE_LEVEL=4
CONFIG_ASSERT=y
CONFIG_SPIN_VALIDATE=y

CONFIG_DEBUG=y
CONFIG_LOG_BACKEND_UART=y

# GPIO interface
CONFIG_GPIO=y

CONFIG_NO_OPTIMIZATIONS=y

# Enable CoAP utils and CoAP protocol
CONFIG_COAP=y

# Generic networking options
CONFIG_NETWORKING=y

# L2 OpenThread enabling
CONFIG_NET_L2_OPENTHREAD=y

# Network shell
CONFIG_SHELL=y
CONFIG_OPENTHREAD_SHELL=y
CONFIG_SHELL_ARGC_MAX=26
CONFIG_SHELL_CMD_BUFF_SIZE=416

# Network sockets
CONFIG_NET_SOCKETS=y
CONFIG_POSIX_API=y
CONFIG_NET_SOCKETS_POLL_MAX=4

# Same network Master Key for client and server
CONFIG_OPENTHREAD_NETWORKKEY="00:11:22:33:44:55:66:77:88:99:aa:bb:cc:dd:ee:ff"

# MAIN STACK SIZE
CONFIG_MAIN_STACK_SIZE=4096
CONFIG_ISR_STACK_SIZE=2048
```

## boards/sparkfun_thing_plus_matter_mgm240p.conf
```kconfig
CONFIG_SOC_GECKO_EMU_DCDC=y
CONFIG_SOC_GECKO_EMU_DCDC_MODE_ON=y
```

## boards/sparkfun_thing_plus_matter_mgm240p.overlay
```dts
/{
    chosen {
        zephyr,ieee802154 = &ieee802154;
    };
};

&ieee802154 {
    status = "okay";
};
```

## boards/xg24_dk2601b.overlay
```dts
/ {
   chosen {
       zephyr,ieee802154 = &ieee802154;
   };
};

&ieee802154 {
    status = "okay";
};
```

## src/main.c
```c
#include <zephyr/kernel.h>
#include <zephyr/logging/log.h>
#include <zephyr/drivers/gpio.h>
#include <zephyr/net/openthread.h>
#include <openthread/thread.h>

LOG_MODULE_REGISTER(coap_client_utils, CONFIG_COAP_CLIENT_UTILS_LOG_LEVEL);

/* 1000 msec = 1 sec */
#define BLINK_SLEEP_TIME_MS   1000
#define OT_SLEEP_TIME_MS      2000

/* The devicetree node identifier for the "led0" alias. */
#define LED0_NODE DT_ALIAS(led0)

/*
 * A build error on this line means your board is unsupported.
 * See the sample documentation for information on how to fix this.
 */
static const struct gpio_dt_spec led = GPIO_DT_SPEC_GET(LED0_NODE, gpios);

/* global variable to store led status */
static bool led_state = true;

/* static work queue callbacks*/
static void blink_led(void){
    for(;;){
        gpio_pin_toggle_dt(&led);
        led_state = !led_state;
        printf("LED state: %s\n", led_state ? "ON" : "OFF");
        k_msleep(BLINK_SLEEP_TIME_MS);
    }   
}

static void init_open_thread(void){
    int error = 0;
    k_msleep(10000);
    error = openthread_start(openthread_get_default_context());
    for(;;){
        //error = !error;
        printf("Open thread state: %s\n", error!=0 ? "Fail in init" : "Correctly init");
        k_msleep(OT_SLEEP_TIME_MS);
    }
    
}

K_THREAD_DEFINE(blink_tid, 1024, blink_led, NULL, NULL, NULL, 7, 0, 0);
K_THREAD_DEFINE(open_thread_tid, 4096, init_open_thread, NULL, NULL, NULL, 5, 0, 0);

int main(void)
{
    int error = 0;
	
    if (!gpio_is_ready_dt(&led)) {
	    return 0;
	}

	error = gpio_pin_configure_dt(&led, GPIO_OUTPUT_ACTIVE);
	if (error < 0) {
	    return 0;
	}

    k_thread_start(blink_tid);
    printf("Start blink led example");

    k_thread_start(open_thread_tid);
    printf("Start open thread");
}
```
